## sdkconfig.defaults
```kconfig
CONFIG_BT_ENABLED=y
CONFIG_BT_CLASSIC_ENABLED=y
CONFIG_BT_BLE_ENABLED=n
CONFIG_BTDM_CTRL_MODE_BR_EDR_ONLY=y
CONFIG_BT_SPP_ENABLED=y
CONFIG_BT_STACK_NO_LOG=n
CONFIG_BTDM_CTRL_HCI_MODE_VHCI=n
CONFIG_BTDM_CTRL_BR_EDR_MAX_ACL_CONN=4
CONFIG_BTDM_CTRL_BR_EDR_MAX_SYNC_CONN=0
CONFIG_BT_SSP_ENABLED=y

# Disable WiFi IRAM optimization to save IRAM
# Note: This may slightly reduce WiFi performance
CONFIG_ESP32_WIFI_IRAM_OPT=n
CONFIG_ESP32_WIFI_RX_IRAM_OPT=n
CONFIG_ESP_WIFI_IRAM_OPT=n
CONFIG_ESP_WIFI_RX_IRAM_OPT=n

# Disable other IRAM optimizations to save IRAM
CONFIG_ESP_EVENT_POST_FROM_IRAM_ISR=n
CONFIG_POST_EVENTS_FROM_IRAM_ISR=n

# Disable SPI IRAM optimization (if not using SPI in ISR)
# Note: Only disable if SPI is not used in interrupt context
# CONFIG_HAL_SPI_MASTER_FUNC_IN_IRAM=n
# CONFIG_HAL_SPI_SLAVE_FUNC_IN_IRAM=n

# Place functions in Flash instead of IRAM to save IRAM
CONFIG_FREERTOS_PLACE_FUNCTIONS_INTO_FLASH=y
CONFIG_RINGBUF_PLACE_FUNCTIONS_INTO_FLASH=y
CONFIG_HEAP_PLACE_FUNCTION_INTO_FLASH=y
CONFIG_FREERTOS_PLACE_SNAPSHOT_FUNS_INTO_FLASH=y

# Ethernet: LAN8720 RMII (ext 50MHz, REF_CLK=GPIO0 input)
CONFIG_ETH_ENABLED=y
CONFIG_ETH_USE_ESP32_EMAC=y
CONFIG_ETH_USE_SPI_ETHERNET=n
CONFIG_ETH_PHY_INTERFACE_RMII=y
CONFIG_ETH_RMII_CLK_INPUT=y
CONFIG_ETH_RMII_CLK_IN_GPIO=0
```
